## kernel/fit-image/fitImage-riscv64.its
```
/*
 * U-Boot uImage source file for the Polarfire SoC Icicle
 */

/dts-v1/;

/ {
	description = "Ubuntu Core kernel, ramdisk, and FDT blob for Microchip's Polarfire SoC Icicle";
	#address-cells = <1>;

	images {
		kernel {
			description = "Ubuntu Kernel";
			data = /incbin/("../../../stage/Image");
			type = "kernel";
			arch = "riscv";
			os = "linux";
			compression = "none";
			load =  <0x00000010 0x04000000>;
			entry = <0x00000010 0x04000000>;
			hash {
				algo = "sha256";
			};
		};
		ramdisk {
			description = "Ubuntu Core ramdisk";
			data = /incbin/("../../../stage/initrd.img");
			type = "ramdisk";
			arch = "riscv";
			os = "linux";
			compression = "none";
			load =  <0x00000010 0x06000000>;
			entry = <0x00000010 0x06000000>;
			hash {
				algo = "sha256";
			};
		};
		fdt-mpfs-icicle-kit.dtb {
			description = "Polarfire SoC Icicle DTB";
			data = /incbin/("../../../stage/dtbs/mpfs-icicle-kit.dtb");
			type = "flat_dt";
			arch = "riscv";
			compression = "none";
			load =  <0x00000010 0x07000000>;
			entry = <0x00000010 0x07000000>;
			hash {
				algo = "sha256";
			};
		};
	};
	configurations {
	default = "mpfs-icicle-kit.dtb";
		mpfs-icicle-kit.dtb {
			description = "Polarfire SoC Icicle";
			kernel = "kernel";
			ramdisk = "ramdisk";
			fdt = "fdt-mpfs-icicle-kit.dtb";
			hash {
				algo = "sha256";
			};
		};
	};
};
```

## kernel/fitImage.its
```
/dts-v1/;
  
/ {
    description = "Configuration to load OpenSBI before U-Boot";
    images {
        ramdisk {
            description = "ramdisk";
            data = /incbin/("parts/kernel/install/initrd.img");
            type = "ramdisk";
            arch = "riscv";
            os = "linux";
            compression = "none";
        };
        kernel {
            description = "Linux kernel";
            data = /incbin/("parts/kernel/install/kernel.img");
            type = "kernel";
            arch = "riscv";
            os = "linux";
            compression = "none";
            load = <0x84000000>;
            entry = <0x84000000>;
        };
    };
    configurations {
        default = "conf_1";
        conf_1 {
            description = "Boot Linux kernel with U-Boot & OpenSBI";
            kernel = "kernel";
            ramdisk = "ramdisk";
        };
    };
};
```

## kernel/sources/fitImage.its
```
/dts-v1/;
  
/ {
    description = "U-Boot fitImage for riscv64 kernel";
    #address-cells = <1>;
  
    images {
        kernel {
            description = "Linux Kernel";
            data = /incbin/("../parts/kernel/install/kernel.img");
            type = "kernel";
            arch = "riscv64";
            os = "linux";
            compression = "none";
            load = <0x80000>;
            entry = <0x80000>;
            hash {
                algo = "sha1";
            };
        };
        fdt {
            description = "Flattened Device Tree blob";
            data = /incbin/("../parts/kernel/install/dtbs/sun20i-d1-lichee-rv-dock.dtb");
            type = "flat_dt";
            arch = "riscv64";
            compression = "none";
            hash {
                algo = "sha1";
            };
        };
        ramdisk {
            description = "ramdisk";
            data = /incbin/("../parts/kernel/install/initrd.img");
            type = "ramdisk";
            arch = "riscv64";
            os = "linux";
            compression = "none";
            hash {
                algo = "sha1";
            };
        };
    };
    configurations {
        default = "conf";
        conf {
            description = "Boot Linux kernel with FDT blob + ramdisk";
            kernel = "kernel";
            fdt = "fdt";
            ramdisk = "ramdisk";
            hash {
                algo = "sha1";
            };
        };
    };
};
```
